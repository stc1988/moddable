## build/devices/esp32/targets/saola_wrover/sdkconfig/sdkconfig.defaults
```kconfig
CONFIG_SPIRAM=y

#
# SPI RAM config
#
CONFIG_SPIRAM_TYPE_AUTO=y
CONFIG_SPIRAM_SIZE=-1

#
# PSRAM clock and cs IO for ESP32S2
#
CONFIG_SPIRAM_CLK_IO=30
CONFIG_SPIRAM_CS_IO=26
# end of PSRAM clock and cs IO for ESP32S2

CONFIG_SPIRAM_SPEED_80M=y
CONFIG_SPIRAM=y
CONFIG_SPIRAM_BOOT_INIT=y
CONFIG_SPIRAM_IGNORE_NOTFOUND=n
CONFIG_SPIRAM_USE_MALLOC=y
CONFIG_SPIRAM_MEMTEST=y
# CONFIG_SPIRAM_MALLOC_ALWAYSINTERNAL=98304
# CONFIG_SPIRAM_MALLOC_RESERVE_INTERNAL=49152
CONFIG_SPIRAM_CACHE_WORKAROUND=y

CONFIG_SPIRAM_CACHE_WORKAROUND_STRATEGY_MEMW=y
CONFIG_SPIRAM_BANKSWITCH_ENABLE=y
CONFIG_SPIRAM_BANKSWITCH_RESERVE=8

CONFIG_ESP_CONSOLE_UART_DEFAULT=y
CONFIG_ESP_CONSOLE_UART=y
CONFIG_ESP_CONSOLE_UART_NUM=0
CONFIG_ESP_CONSOLE_UART_BAUDRATE=115200
```

## build/devices/esp32/xsProj-esp32p4/sdkconfig.defaults
```kconfig
CONFIG_BOOTLOADER_LOG_LEVEL_NONE=y
CONFIG_APP_RETRIEVE_LEN_ELF_SHA=16
CONFIG_ESPTOOLPY_FLASHSIZE_4MB=y
CONFIG_PARTITION_TABLE_CUSTOM=y
# CONFIG_ESP_ERR_TO_NAME_LOOKUP is not set
# CONFIG_ESP_HTTP_CLIENT_ENABLE_HTTPS is not set
CONFIG_ESP_CONSOLE_NONE=y
# CONFIG_ESP_INT_WDT is not set
# CONFIG_ESP_TASK_WDT_EN is not set
CONFIG_ESP_BROWNOUT_DET_LVL_SEL_7=y
CONFIG_ESP_COREDUMP_ENABLE_TO_NONE=y
CONFIG_FATFS_LFN_HEAP=y
CONFIG_FREERTOS_HZ=1000
CONFIG_FREERTOS_CHECK_STACKOVERFLOW_PTRVAL=y
CONFIG_FREERTOS_IDLE_TASK_STACKSIZE=1024
CONFIG_FREERTOS_USE_TRACE_FACILITY=y
CONFIG_FREERTOS_ISR_STACKSIZE=2100
CONFIG_LOG_DEFAULT_LEVEL_NONE=y
CONFIG_LWIP_MAX_SOCKETS=4
CONFIG_LWIP_IPV6_AUTOCONFIG=y
CONFIG_LWIP_TCP_SYNMAXRTX=6
CONFIG_LWIP_TCP_MSS=1436
CONFIG_LWIP_TCP_SND_BUF_DEFAULT=5744
CONFIG_LWIP_TCP_WND_DEFAULT=5744
CONFIG_LWIP_TCP_RTO_TIME=3000
CONFIG_LWIP_TCPIP_TASK_STACK_SIZE=2560
CONFIG_MBEDTLS_ECP_RESTARTABLE=y
CONFIG_PTHREAD_TASK_STACK_SIZE_DEFAULT=2048
#
# Bluetooth
#
CONFIG_BT_ENABLED=n
CONFIG_BT_BLUEDROID_ENABLED=n
CONFIG_BT_NIMBLE_ENABLED=n

CONFIG_LIBC_NEWLIB_NANO_FORMAT=y
```
